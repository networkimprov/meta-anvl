## conf/machine/anvl.conf
```bitbake
#@TYPE: Machine
#@NAME: ANVL machine
#@DESCRIPTION: Machine configuration for the ANVL board 

require include/omap3.inc

PREFERRED_PROVIDER_virtual/kernel = "linux-anvl"

UBOOT_MACHINE = "omap3_anvl"

IMAGE_FSTYPES_append = " tar.bz2"

MACHINE_FEATURES = "kernel26 screen apm usbgadget usbhost vfat alsa wifi mmc mmcroot"
```
